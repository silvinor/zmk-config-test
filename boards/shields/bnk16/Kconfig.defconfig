## boards/shields/bnk16/Kconfig.defconfig
```kconfig
if SHIELD_BNK16

config ZMK_KEYBOARD_NAME
	default "Binepad BNK-16"

config ZMK_USB
	default y

config GPIO
	default y

config ZMK_KSAN_DIRECT_POLLING
	bool "Enable direct polling for kscan"
	default y

endif
```
